#include <Wire.h>
#include <WiFi.h>
#include <Adafruit_GFX.h>
#include <Adafruit_SSD1306.h>
#include <Arduino.h>
#include <neotimer.h>

Neotimer loadTimer = Neotimer(2000);

// Config for WiFi
const char* ssid = "SYL";

// Config for LED
#define LED_PIN 5


// Config for Screen
#define SCREEN_WIDTH 128
#define SCREEN_HEIGHT 64
#define OLED_ADDR 0x3C
Adafruit_SSD1306 display(SCREEN_WIDTH, SCREEN_HEIGHT, &Wire, -1);

// Config for Button
const int BUTTON_PIN = 37;          // 按钮连接的引脚
const int BUTTON_POWER_PIN = 38;
const unsigned long DEBOUNCE_DELAY = 50;  // 防抖时间（毫秒）
int lastButtonState = LOW;         // 上一次读取的按钮状态
int buttonState = LOW;             // 当前稳定的按钮状态
unsigned long lastDebounceTime = 0;  // 上次状态变化时的时间

// Global config
bool isEnabled = false;
enum modeList {
  MENU, MALE, FEMALE
};
modeList currentMode = MENU;

const unsigned char epd_bitmap_yuzusoft [] PROGMEM = {
	0x00, 0x00, 0x00, 0x00, 0x00, 0x00, 0x00, 0x00, 0x00, 0x00, 0x00, 0x00, 0x00, 0x00, 0x00, 0x00, 
	0x00, 0x00, 0x00, 0x00, 0x00, 0x00, 0x00, 0x00, 0x00, 0x00, 0x00, 0x00, 0x00, 0x00, 0x00, 0x00, 
	0x00, 0x00, 0x00, 0x00, 0x00, 0x00, 0x00, 0x00, 0x00, 0x00, 0x00, 0x00, 0x00, 0x00, 0x00, 0x00, 
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	0x00, 0x00, 0x00, 0x00, 0x00, 0x00, 0x00, 0x00, 0x00, 0x00, 0x00, 0x00, 0x00, 0x00, 0x00, 0x00
};


void setup() {
  Serial.begin(9600);
  loadTimer.start();
  pinMode(LED_PIN, OUTPUT);
  setupWIFI();
  setupButton();
  setupDisplay();
  
}

void loop() {
  checkButton();
  Serial.printf("millis: %d\n", millis());
  digitalWrite(LED_PIN, LOW);  // 低电平点亮（常见设计）
  // Serial.printf("currentMode: %d\n", currentMode);
  if (!loadTimer.done()) return;
  switch (currentMode)
  {
    case MENU:
      drawWIFIDebug();
      break;
    case MALE:
      drawMale();
      convertMale();
      break;
    case FEMALE:
      drawFemale();
      convertFemale();
      break;
    default:
      return;
  }
}

void setupWIFI() {
  Serial.print("Connecting to open WiFi: ");
  Serial.println(ssid);
  WiFi.begin(ssid); //  只需要 SSID，不需要密码

  while (WiFi.status() != WL_CONNECTED) {
    delay(500);
    Serial.print(".");
  }

  Serial.println("");
  Serial.println("WiFi connected");
  Serial.println("IP address: ");
  Serial.println(WiFi.localIP());
}

void setupButton() {
  pinMode(BUTTON_PIN, INPUT_PULLDOWN);
  pinMode(BUTTON_POWER_PIN, OUTPUT); // Setup power for the button
}

void setupDisplay() {
  Wire.begin(8, 9);
  display.begin(SSD1306_SWITCHCAPVCC, OLED_ADDR);
  display.clearDisplay();
  display.drawBitmap(0, 0, epd_bitmap_yuzusoft, 128, 64, WHITE);
  display.display();
  
  display.clearDisplay();
}

void switchMode() {
  currentMode = static_cast<modeList>((static_cast<int>(currentMode) + 1) % 3);
  Serial.printf("current mode: %d", currentMode);
}

void checkButton() {
  // 读取当前按钮状态
  digitalWrite(BUTTON_POWER_PIN, HIGH);
  int reading = digitalRead(BUTTON_PIN);

  // 如果读取值与上次记录的不一样，说明可能刚发生跳变，将计时器重置
  if (reading != lastButtonState) {
    lastDebounceTime = millis();
  }

  // 如果经过防抖时长后，按钮状态保持稳定，则认为状态已经改变
  if ((millis() - lastDebounceTime) > DEBOUNCE_DELAY) {
    // 如果稳定状态与上一次记录的不一样，则执行任务
    if (reading != buttonState) {
      buttonState = reading;

      // 这里只在按钮从低电平切换到高电平时触发，如果你的电路接法不同请相应调整判断条件
      if (buttonState == HIGH) {
        switchMode();
      }
    }
  }
  // 保存本次读取值，供下一轮比较
  lastButtonState = reading;
}

void drawCos() {
  if (currentMode != MENU) return;

  static float phase = 0; // 相位偏移量
  display.clearDisplay();
  
  // 绘制坐标轴
  display.drawFastHLine(0, 31, SCREEN_WIDTH, SSD1306_WHITE); // X轴
  display.drawFastVLine(0, 0, SCREEN_HEIGHT, SSD1306_WHITE); // Y轴
  
  // 绘制余弦波形
  for(int x = 0; x < SCREEN_WIDTH; x++) {
    // 计算角度（包含相位偏移）
    float angle = (x + phase) * 2 * PI / SCREEN_WIDTH;
    // 计算余弦值并映射到屏幕坐标
    int y = 31 - (int)(30 * cos(angle)); // 31为垂直中心，30为振幅
    
    // 绘制波形点
    display.drawPixel(x, y, SSD1306_WHITE);
  }

  // 更新显示并调整相位
  display.display();
  phase += 1.5; // 控制波形移动速度
  
  // 相位复位
  if(phase >= SCREEN_WIDTH) {
    phase = 0;
  }
}

void drawMenuText(const char* string) {
  uint16_t textWidth, textHeight = 0;
  int16_t x, y;
  display.clearDisplay();
  display.setTextSize(1);
  display.setTextColor(WHITE, BLACK);
  display.getTextBounds(string, 0, 0, &x, &y, &textWidth, &textHeight);
  display.setCursor(display.width() / 2 - textWidth / 2, display.height() / 2 - textHeight / 2);
  display.print(string);
  display.display();
}

void drawWIFIDebug() {
  if (WiFi.status() == WL_CONNECTED) { // 检查 WiFi 是否已连接
    String wifiInfo = "WIFI connected to ";
    wifiInfo += WiFi.SSID(); // 获取 SSID
    wifiInfo += "\n";
    wifiInfo += "IP:";
    wifiInfo += WiFi.localIP().toString(); // 获取 IP 地址并转换为字符串
    drawMenuText(wifiInfo.c_str()); // 将组合后的字符串传递给 drawMenuText
  } else {
    drawMenuText("WiFi not connected"); // 如果未连接，显示提示信息
  }
}

void drawMale() {
  drawMenuText("Male");
}

void drawFemale() {
  drawMenuText("Female");
}

void convertMale() {
}

void convertFemale() {

}

